## secret_agent/SAC2/go-tls-esp32-project/esp32/kconfig.projbuild
```kconfig
menu "ESP32 Project Configuration"

    config WIFI_SSID
            string "WIFI SSID"
            default "myssid"
            help
                SSID (network name) for us to connect to.

    config WIFI_PASSWORD
            string "WiFi Password"
            default "mypassword"
            help
                WiFi password (WPA or WPA2) to connect to.

    config CA_CERT
            string "CA Certificate"
            default "certs/ca.cert"
            help
                Path to the Certificate Authority (CA) certificate.

    config SERVER_CERT
            string "Server Certificate"
            default "certs/server.cert"
            help
                Path to the server's public certificate.

    config SERVER_KEY
            string "Server Key"
            default "certs/server.key"
            help
                Path to the server's private key.

endmenu
```

## secret_agent/SAC2/main/kconfig.projbuild
```kconfig
menu "TLS project Configuration"

    config WIFI_SSID
            string "WIFI SSID"
            default "myssid"
            help
                SSID (network name) for us to connect to.

    config WIFI_PASSWORD
            string "WiFi Password"
            default "mypassword"
            help
                WiFi password (WPA or WPA2) to connect to.

    config KEY_PASSWORD
            string "Key Password"
            default "mykey"
            help
                Key password for decrypting server private key.
                
endmenu
```
